#include "NTT.h"
#include "utils.h"
#include "parameters.h"
#include <avr/pgmspace.h>

const PROGMEM int psi_rev[N]     = {1,-16,64,4,-8,128,2,-32,-121,-120,-34,30,-60,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-91,-86};
const PROGMEM int inv_psi_rev[N] = {86,91,-87,-107,-75,85,43,-83,80,-5,-63,20,-10,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16,-1};


void NTT(Poly* p){
    int s, j, t, l, zeta, k=1;
    
    for(l=N>>1; l > 0; l >>= 1)
        for(s=0; s < N; s = j+l){
            zeta = pgm_read_word_near(psi_rev+k);
            k++;
            for(j=s; j < s+l; ++j){
              t = zeta*p->c[j+l];
              p->c[j+l] = mod_q(p->c[j] - t);
              p->c[j]   = mod_q(p->c[j] + t); 
            }
        }
}

void INTT(Poly* p){
    int s, j, t, l, k=0;

    for(l=1; l < N; l <<= 1)
        for(s=0; s < N; s = j+l){
            for(j=s; j < s+l; ++j){
                t = p->c[j];
                p->c[j] = mod_q(t+p->c[j+l]);
                p->c[j+l] = t - p->c[j+l]; 
                p->c[j+l] = mm257(pgm_read_word_near(inv_psi_rev+k),p->c[j+l]); 
            }
            ++k;
        }
    for(j=0; j < N; ++j) p->c[j] = mm257(p->c[j],inv_N);
}

