#include "kem.h"
#include "utils.h"
#include "NTT.h"
#include <stdlib.h>
#include <avr/pgmspace.h>

const PROGMEM Poly A[K*K] = {{101, 102, 51, 6, -107, 104, -52, 113, -73, -60, -34, 83, 58,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 123, 90}, {-124, 86, -27, 74, -2, -31, -16, -128, 65, 98, -20, -19, 124,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 110, 74}, {-104, 34, -116, -59, -37, 114, -100, 78, -118, -75, -45, -28, 115,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 12, 10}, {-18, 95, 17, -117, -11, 119, 116, -76, -43, -106, 126, -45, -29,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 -105, 65}, {41, 32, -123, 21, 9, 77, 17, -4, -66, 25, -43, -47, 18,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 41, -26}, {43, 128, -101, -75, -111, -50, 104, -99, 92, 7, -96, 14, 11,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 66, 56}, {-92, -86, -53, -4, 89, 23, -30, -32, -103, 124, 32, 100, 37,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 -56, 104}, {18, -118, -9, -35, 109, 72, -44, -127, -87, 104, 49, 62, -42,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 -54, 54}, {-76, 38, -91, 47, 114, -45, 91, -67, -39, 58, -95, -33, -79,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 -26, -100}};
const PROGMEM Poly S[K] = {{119, -121, 99, -38, -20, -49, 33, -118, -81, 74, -80, -27, -30,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 13, 89}, {-127, 83, 41, -118, -12, 127, 54, -81, 86, 94, 92, -69, 104,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 127, -89}, {-53, 33, 58, 81, 72, -25, -12, 12, -120, -63, -15, 74, -2,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 92, -8}};
const PROGMEM Poly T[K] = {{71, 15, -7, -77, 25, 44, 123, -8, -43, 99, 33, -94, -52,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 106, -95}, {38, 97, -122, -10, -85, -5, 73, 28, 63, -111, -57, -128, -25,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 109, -87}, {73, 3, -62, 3, -87, 70, 117, 107, 52, -17, 87, -74, -35,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 -87, 67}};
const PROGMEM unsigned char z[LAMBDA]={0xDE, 0xAD, 0xBE, 0xEF};


void add_key(Poly* p, unsigned char* k){
    /*
     * Adds encoding of k to the polynomial p
     */
    int i;
    
    for(i=0; i < LAMBDA*8; ++i) p->c[i] = mod_q(p->c[i] + ((k[i/8]>>(i%8))&1)*(Q/2));
}

void decode_key(const Poly* p, unsigned char* k){
    /*
     * Threshold decodes p and put the result in k
     */
    int i, v; 
    
    for(i=0; i < LAMBDA;   ++i) k[i] = 0;
    for(i=0; i < LAMBDA*8; ++i){
        v = p->c[i];
        k[i/8] += (((v > Q/4) || (v < -Q/4)) << (i%8));
    }
}

void fill_error_poly(Poly* p, unsigned char* r){
    /*
     * Sets p to an error polynomial.
     * Uses ERROR_POLY_ENTROPY bytes of r
     */
    int i;
    
    for(i=0; i < N/4;++i){
        p->c[i*4+0] = ((r[i] >> 0)&1) - ((r[i] >> 1)&1);
        p->c[i*4+1] = ((r[i] >> 2)&1) - ((r[i] >> 3)&1);
        p->c[i*4+2] = ((r[i] >> 4)&1) - ((r[i] >> 5)&1);
        p->c[i*4+3] = ((r[i] >> 6)&1) - ((r[i] >> 7)&1);   
    }
    
}

void sub_poly_packed(const Packed_poly* a, const Poly* b, Poly* res){
    /*
     * Computes a - b and puts the result in res
     * A is in packed form
     */
    int i;
    
    for(i=0; i < N; ++i) res->c[i] = mod_q( unpack_coef(a,i) - b->c[i]); 

}

void pgm_dot_product_packed(const Poly* A, const Packed_poly* B, Poly* temp, int k){
    /*
     * Computes dot product between to vectors of length k and puts the result in temp
     * All polynomials should be in frequency domain
     * A is stored unpacked in flash memory
     * B is in packed form
     */
    int i,j;
    
    for(j=0; j < N; ++j) temp->c[j] = mm257(pgm_read_word_near(A[0].c + j),unpack_coef(B,j));
    for(i=1; i < k; ++i) for(j=0; j < N; ++j) temp->c[j] = mod_q(temp->c[j] + pgm_read_word_near(A[i].c + j) * unpack_coef(&B[i],j)); 

}


void pgm_pointwise_add_mul_packed(const Poly* a, const Poly* b, Packed_poly* res){
    /*
     * Computes res = res + a * b with res in packed form
     * All polynomials should be in frequency domain 
     */
    int i, v;
    
    for(i=0; i < N; ++i) {
      v = unpack_coef(res,i);
      v = mod_q(v + pgm_read_word_near(a->c + i) * b->c[i]); 
      pack_coef(res, i, v);
    }
}
/*
void CCA_encaps(Packed_poly* ct, unsigned char* k){
    int i;
    unsigned char pk_m[2*LAMBDA];
    unsigned char k_hat_r[2*LAMBDA];
    
    for(i= 0; i < LAMBDA; ++i) pk_m[i] = pgm_read_word(T[0].c + i)&0xFF;
    for(i=LAMBDA; i < 2*LAMBDA; ++i) pk_m[i] = random()&0xFF;   

    H(k_hat_r, 2*LAMBDA, pk_m, 2*LAMBDA); //K,r = G(pk,m)
    encaps(ct,ct+K, pk_m+LAMBDA, k_hat_r+LAMBDA);
    
    for(i=LAMBDA; i < 2*LAMBDA; ++i) k_hat_r[i] = ct->bytes[i];
    
    H(k, LAMBDA, k_hat_r,2*LAMBDA);
}

void CCA_decaps(Packed_poly* ct, unsigned char* k){
    unsigned char pk_m[2*LAMBDA];
    unsigned char k_hat_r[2*LAMBDA];
    unsigned char h1[LAMBDA];
    unsigned char h2[LAMBDA];
    int i, correct=1;
    
    for(i=0; i < LAMBDA; ++i) pk_m[i] = pgm_read_word(T[0].c + i)&0xFF;
    
    decaps(ct,ct+K, pk_m+LAMBDA);
    H(k_hat_r, 2*LAMBDA, pk_m, 2*LAMBDA); //K,r = G(pk,m)
    H(h1, LAMBDA, ct->bytes,(K+1)*PACK_SIZE);  

    encaps(ct, ct+K, pk_m+LAMBDA, k_hat_r+LAMBDA);
    H(h2, LAMBDA, ct->bytes, (K+1)*PACK_SIZE); 

    for(i=0; i < LAMBDA; ++i) correct = correct & (h1[i] == h2[i]);
     
    correct = -correct; // 0x000000 or 0xFFFFFFFF
    
    for(i=0; i < LAMBDA; ++i)         k_hat_r[i] = (k_hat_r[i]&correct) | (pgm_read_word(z+i)&(~correct));
    for(i=LAMBDA; i < 2*LAMBDA; ++i)  k_hat_r[i] = ct->bytes[i];
    
    H(k, LAMBDA, k_hat_r,2*LAMBDA);
    
}*/


void CCA_encaps(CCA_ciphertext* ct, unsigned char* k){
    int i;
    unsigned char pk_m[2*LAMBDA];
    unsigned char k_hat_r[2*LAMBDA];
    
    for(i= 0; i < LAMBDA; ++i) pk_m[i] = pgm_read_word(T[0].c + i)&0xFF;
    for(i=LAMBDA; i < 2*LAMBDA; ++i) pk_m[i] = random()&0xFF;   

    H(k_hat_r, 2*LAMBDA, pk_m, 2*LAMBDA); //K,r = G(pk,m)
    encaps(ct->U,&(ct->V), pk_m+LAMBDA, k_hat_r+LAMBDA);
    
    for(i=0; i < LAMBDA; ++i) ct->nonce[i] = k_hat_r[i];
    
    H(k, LAMBDA, ct->nonce, LAMBDA+(K+1)*PACK_SIZE);
}

void CCA_decaps(CCA_ciphertext* ct, unsigned char* k){
    unsigned char pk_m[2*LAMBDA];
    unsigned char k_hat_r[2*LAMBDA];
    unsigned char h1[LAMBDA];
    unsigned char h2[LAMBDA];
    int i, correct=1;
    
    for(i=0; i < LAMBDA; ++i) pk_m[i] = pgm_read_word(T[0].c + i)&0xFF;
    
    decaps(ct->U,&(ct->V), pk_m+LAMBDA);
    H(k_hat_r, 2*LAMBDA, pk_m, 2*LAMBDA); //K,r = G(pk,m)
    H(h1, LAMBDA, (ct->U)->bytes, (K+1)*PACK_SIZE);  

    encaps(ct->U,&(ct->V), pk_m+LAMBDA, k_hat_r+LAMBDA);
    H(h2, LAMBDA, (ct->U)->bytes, (K+1)*PACK_SIZE); 

    for(i=0; i < LAMBDA; ++i) correct = correct & (h1[i] == h2[i]);
     
    correct = -correct; // 0x000000 or 0xFFFFFFFF
    
    for(i=0; i < LAMBDA; ++i) ct->nonce[i] = (k_hat_r[i]&correct) | (pgm_read_word(z+i)&(~correct));

    
    H(k, LAMBDA, ct->nonce, LAMBDA+(K+1)*PACK_SIZE);
    
}

void encaps(Packed_poly* U, Packed_poly* V, unsigned char* k, unsigned char* randomness){ 
    int i, j, random_size = (1+2*K)*ERROR_POLY_ENTROPY;  
    unsigned char random_tape[random_size]; 
    Poly x; 
    
    XOF(random_tape, random_size, randomness, LAMBDA); // extend seed into large entropy pool

    fill_error_poly(&x, random_tape); 
    add_key(&x,k);
    NTT(&x);
    pack(&x,V);    

    for(i=0; i < K; ++i){ // sample packed vector in K-rank module, coef. of ring elements from binomial 1 dist.
        fill_error_poly(&x, random_tape+ERROR_POLY_ENTROPY*(i+1));
        NTT(&x); // frequency domain
        pack(&x, &U[i]);
    }
    
    for(i=0; i < K; ++i){ // Matrix-vector multiplication with iterative sampling
        fill_error_poly(&x,random_tape+ERROR_POLY_ENTROPY*(K+1+i));
        NTT(&x);
        
        for(j=0; j < K; ++j) pgm_pointwise_add_mul_packed(&A[i*K + j], &x, &U[j]);   
                 
        pgm_pointwise_add_mul_packed(&T[i],&x,V);
    }
}


void decaps(Packed_poly* U, Packed_poly* V, unsigned char* k){
    Poly temp;
    
    pgm_dot_product_packed(S, U, &temp, K);
    sub_poly_packed(V, &temp, &temp);
    INTT(&temp);
    decode_key(&temp, k);
}

