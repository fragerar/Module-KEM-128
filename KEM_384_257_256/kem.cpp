#include "kem.h"
#include "utils.h"
#include "NTT.h"
#include <stdlib.h>
#include <avr/pgmspace.h>
#include <Arduino.h>


const PROGMEM Poly A[K*K] = {{8, 20, -121, 57, -26, -4, 63, 91, 110, 127, -36, -96, 80,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 -5, 55},{84, 104, -107, -67, 72, -69, -15, 2, -126, -35, 82, -103, -59,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 -52, -11},{91, -39, -45, 74, -74, -88, 77, 45, -9, -56, 66, 15, 38,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 51, -81},{-8, -56, 17, 56, -64, 60, -46, 91, 20, 99, 82, -45, 121,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 64, -22},{98, -110, -104, -88, 6, -30, 8, -11, 98, 69, 126, -88, 97,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 -29, 59},{10, 127, -46, 26, -49, 55, -99, 127, 61, -36, 30, -83, 121,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 -68, 79},{51, -104, 109, -55, 11, 37, -51, -99, -35, -68, -17, 48, -93,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 36, 43},{64, -124, 127, 57, -86, 7, 18, 91, 94, -2, 91, -57, -58,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 -102, 2},{-38, 115, 21, -55, -48, 15, 119, -121, 118, 86, -110, 98, -32,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 -92, 114}};
const PROGMEM Poly S[2*K] = {{-11, -88, -120, 40, -128, -55, 77, 57, 51, -114, 54, -100, 116,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 76, -61},{-56, -65, -39, -30, 109, 8, 84, -12, 92, -68, 37, 85, 92,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 78, 125},{128, -106, 90, -64, -26, 127, 101, 111, -90, -33, 67, -31, -91,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 116, -47},{96, -34, -34, -102, -71, -45, 106, 77, 116, -87, 52, 113, -47,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 -79, -50},{-91, 64, -124, 44, -74, 51, 25, -78, 124, 89, 117, -77, -121,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 50, 29},{-41, 79, -93, 77, -67, 83, 96, 82, 100, 16, -53, -117, 125,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 -18, 14}};
const PROGMEM Poly T[2*K] = {{-125, 87, 46, 128, 100, -115, 50, 26, -19, 10, 63, -42, 4,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 -113, -90},{-26, -109, 25, -80, 114, -30, -15, 107, 22, -95, 88, -55, -8,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 19, 16},{115, -67, -81, 81, 12, -123, -84, -55, -36, -93, 99, -28, -6,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 -113, 56},{-119, -51, -118, -93, 4, -29, -110, -80, -92, 116, 36, 47, 121,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 82, -73},{0, 9, 72, 40, -110, 82, 8, -81, -52, -32, 107, -107, -84,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 16, 121},{-2, -66, -46, 39, 31, 40, -82, -121, 109, -120, -86, -2, -17,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 126, 128}};

const PROGMEM unsigned char z[LAMBDA]={0xDE, 0xAD, 0xBE, 0xEF};


void add_key(Poly* p, unsigned char* k){
    /*
     * Adds encoding of k to the polynomial p
     */
    int i;
    
    for(i=0; i < LAMBDA*4; ++i) p->c[i] = mod_q(p->c[i] + ((k[i/8]>>(i%8))&1)*(Q/2));
}

void decode_key(const Poly* p, unsigned char* k){
    /*
     * Threshold decodes p and put the result in k
     */
    int i, v; 
    
    for(i=0; i < LAMBDA/2;   ++i) k[i] = 0;
    for(i=0; i < LAMBDA*4; ++i){
        v = p->c[i];
        k[i/8] += (((v > Q/4) || (v < -Q/4)) << (i%8));
    }
}

void fill_error_poly(Poly* p, unsigned char* r){
    /*
     * Sets p to an error polynomial.
     * Uses ERROR_POLY_ENTROPY bytes of r
     */
    int i;
    
    for(i=0; i < N/4;++i){
        p->c[i*4+0] = ((r[i] >> 0)&1) - ((r[i] >> 1)&1);
        p->c[i*4+1] = ((r[i] >> 2)&1) - ((r[i] >> 3)&1);
        p->c[i*4+2] = ((r[i] >> 4)&1) - ((r[i] >> 5)&1);
        p->c[i*4+3] = ((r[i] >> 6)&1) - ((r[i] >> 7)&1);   
    }
    
}

void sub_poly_packed(const Packed_poly* a, const Poly* b, Poly* res){
    /*
     * Computes a - b and puts the result in res
     * A is in packed form
     */
    int i;
    
    for(i=0; i < N; ++i) res->c[i] = mod_q( unpack_coef(a,i) - b->c[i]); 

}

void pgm_dot_product_packed(const Poly* A, const Packed_poly* B, Poly* temp, int k){
    /*
     * Computes dot product between to vectors of length k and puts the result in temp
     * All polynomials should be in frequency domain
     * A is stored unpacked in flash memory
     * B is in packed form
     */
    int i,j;
    
    for(j=0; j < N; ++j) temp->c[j] = mm257(pgm_read_word_near(A[0].c + j),unpack_coef(B,j));
    for(i=1; i < k; ++i) for(j=0; j < N; ++j) temp->c[j] = mod_q(temp->c[j] + pgm_read_word_near(A[i].c + j) * unpack_coef(&B[i],j)); 

}


void pgm_pointwise_add_mul_packed(const Poly* a, const Poly* b, Packed_poly* res){
    /*
     * Computes res = res + a * b with res in packed form
     * All polynomials should be in frequency domain 
     */
    int i, v;
    
    for(i=0; i < N; ++i) {
      v = unpack_coef(res,i);
      v = mod_q(v + pgm_read_word_near(a->c + i) * b->c[i]); 
      pack_coef(res, i, v);
    }
}



void CCA_encaps(CCA_ciphertext* ct, unsigned char* k){
    int i;
    unsigned char pk_m[2*LAMBDA];
    unsigned char k_hat_r[2*LAMBDA];
    
    for(i= 0; i < LAMBDA; ++i) pk_m[i] = pgm_read_word(T[0].c + i)&0xFF;
    for(i=LAMBDA; i < 2*LAMBDA; ++i) pk_m[i] = random()&0xFF;   

    H(k_hat_r, 2*LAMBDA, pk_m, 2*LAMBDA); //K,r = G(pk,m)
    encaps(ct->U, ct->V, pk_m+LAMBDA, k_hat_r+LAMBDA);
    
    for(i=0; i < LAMBDA; ++i) ct->nonce[i] = k_hat_r[i];
    
    H(k, LAMBDA, ct->nonce, LAMBDA+(K+2)*PACK_SIZE);
}

void CCA_decaps(CCA_ciphertext* ct, unsigned char* k){
    unsigned char pk_m[2*LAMBDA];
    unsigned char k_hat_r[2*LAMBDA];
    unsigned char h1[LAMBDA];
    unsigned char h2[LAMBDA];
    int i, correct=1;
    
    for(i=0; i < LAMBDA; ++i) pk_m[i] = pgm_read_word(T[0].c + i)&0xFF;
    
    decaps(ct->U, ct->V, pk_m+LAMBDA);
    H(k_hat_r, 2*LAMBDA, pk_m, 2*LAMBDA); //K,r = G(pk,m)
    H(h1, LAMBDA, (ct->U)->bytes, (K+2)*PACK_SIZE);  

    encaps(ct->U, ct->V, pk_m+LAMBDA, k_hat_r+LAMBDA);
    H(h2, LAMBDA, (ct->U)->bytes, (K+2)*PACK_SIZE); 

    for(i=0; i < LAMBDA; ++i) correct = correct & (h1[i] == h2[i]);
     
    correct = -correct; // 0x000000 or 0xFFFFFFFF
    
    for(i=0; i < LAMBDA; ++i) ct->nonce[i] = (k_hat_r[i]&correct) | (pgm_read_word(z+i)&(~correct));
    
    H(k, LAMBDA, ct->nonce, LAMBDA+(K+2)*PACK_SIZE);
    
}

void encaps(Packed_poly* U, Packed_poly* V, unsigned char* k, unsigned char* randomness){ 
    int i, j, random_size = (2+2*K)*ERROR_POLY_ENTROPY;  
    unsigned char random_tape[random_size]; 
    Poly x; 
    
    XOF(random_tape, random_size, randomness, LAMBDA); // extend seed into large entropy pool

    fill_error_poly(&x, random_tape); 
    add_key(&x,k);
    NTT(&x);
    pack(&x,V);    

    fill_error_poly(&x, random_tape+ERROR_POLY_ENTROPY); 
    add_key(&x,k+LAMBDA/2);
    NTT(&x);
    pack(&x,V+1);    

    for(i=0; i < K; ++i){ // sample packed vector in K-rank module, coef. of ring elements from binomial 1 dist.
        fill_error_poly(&x, random_tape+ERROR_POLY_ENTROPY*(i+2));
        NTT(&x); // frequency domain
        pack(&x, &U[i]);
    }
    
    for(i=0; i < K; ++i){ // Matrix-vector multiplication with iterative sampling
        fill_error_poly(&x,random_tape+ERROR_POLY_ENTROPY*(K+2+i));
        NTT(&x);
        
        for(j=0; j < K; ++j) pgm_pointwise_add_mul_packed(&A[i*K + j], &x, &U[j]);   
                 
        pgm_pointwise_add_mul_packed(&T[i],&x,V);
        pgm_pointwise_add_mul_packed(&T[K+i],&x,V+1);
    }
}


void decaps(Packed_poly* U, Packed_poly* V, unsigned char* k){
    Poly temp;
    
    pgm_dot_product_packed(S, U, &temp, K);
    sub_poly_packed(V, &temp, &temp);
    INTT(&temp);
    decode_key(&temp, k);

    pgm_dot_product_packed(S+K, U, &temp, K);
    sub_poly_packed(V+1, &temp, &temp);
    INTT(&temp);
    decode_key(&temp, k+LAMBDA/2);
}

